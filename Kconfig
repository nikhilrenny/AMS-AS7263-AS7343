## drivers/sensor/as7263/Kconfig
```kconfig
# AS7263 6-channel NIR spectral sensor driver

config AS7263
	bool "AS7263 NIR spectral sensor"
	default y
	depends on DT_HAS_AMS_AS7263_ENABLED
	select I2C
	help
	  Enable driver for the AMS AS7263 6-channel NIR spectral sensor.
	  Uses the AS726x polled virtual-register I2C protocol (no direct
	  register file, no SMUX).

if AS7263

config AS7263_LED
	bool "Enable LED driver attribute support"
	default y
	help
	  Exposes SENSOR_ATTR_AS7263_LED_ON / LED_DRIVE for LED_DRV.

endif # AS7263
```

## drivers/sensor/as7343/Kconfig
```kconfig
# AS7343 14-channel multispectral sensor driver

config AS7343
	bool "AS7343 multispectral sensor"
	default y
	depends on DT_HAS_AMS_AS7343_ENABLED
	select I2C
	help
	  Enable driver for the AMS AS7343 14-channel multispectral sensor.
	  Uses Direct Chain Configuration for full 18-channel custom SMUX
	  mapping (not limited to the RAM/SMUXEN default).

if AS7343

config AS7343_LED
	bool "Enable LED driver (LDR pin) attribute support"
	default y
	help
	  Exposes SENSOR_ATTR_AS7343_LED_ON / LED_DRIVE. Disable if LDR pin
	  is left unconnected to save a small amount of code space.

config AS7343_GPIO
	bool "Enable GPIO pin attribute support"
	default n
	help
	  Exposes SENSOR_ATTR_AS7343_GPIO_MODE / GPIO_OUT for the sensor's
	  own GPIO pin (sync/trigger use). Disable if unused.

config AS7343_FLICKER
	bool "Enable flicker detection (FD) support"
	default n
	help
	  Exposes SENSOR_ATTR_AS7343_FD_GAIN and related flicker-detection
	  register access. Not used in LEAF's reflectance/fluorescence path.

endif # AS7343
```

## dts/bindings/sensor/ams,as7343.yaml
```yaml
# AS7343 14-channel multispectral sensor devicetree binding.

description: |
  AMS AS7343 14-channel multispectral sensor (18 channels with SMUX
  Direct Chain Configuration across 3 chains). I2C, fixed 7-bit address
  0x39. Not SparkFun-specific — this binding applies to any board
  carrying the bare AS7343 die (SparkFun breakout, custom LEAF PCB, etc).

compatible: "ams,as7343"

include: [i2c-device.yaml]

properties:
  again:
    type: int
    default: 9
    description: |
      Default AGAIN spectral gain setting (0-12, maps to 0.5x-2048x per
      datasheet CFG1 register). Default 9 = 256x.

  atime:
    type: int
    default: 29
    description: Default ATIME integration-step count (0-255).

  astep:
    type: int
    default: 599
    description: Default ASTEP integration step size (0-65534).

  channel-count:
    type: string
    enum:
      - "6"
      - "12"
      - "18"
    default: "18"
    description: |
      Number of channels read per sample_fetch. 18 uses all 3 Direct
      Chain SMUX chains; 6/12 use fewer chains for faster cycles.

  led-present:
    type: boolean
    description: Set if an external LED is wired to the LDR pin.

  int-gpios:
    type: phandle-array
    description: Optional INT pin (active-low, open-drain).
```
